
// SPDX-License-Identifier: GPL-2.0-or-later OR MIT
/*
 * Copyright © 2025 OPTO logic Tenchnology S.A.
 * Author: Enguerrand de Ribaucourt <enguerrand.de.ribaucourt@savoirfairelinux.com>
 */

// Verdin iMX8M Mini single-channel LVDS for 5 inch OPTO Logic display (SCX0500132GGC06)
// Extends verdin-imx8mm_dsi-to-lvds_panel-cap-touch-10inch-lvds_overlay.dts
// And verdin-imx8mm_panel-cap-touch-10inch-dsi_overlay.dts for the touchscreen example

/dts-v1/;
/plugin/;

#include <dt-bindings/gpio/gpio.h>
#include <dt-bindings/interrupt-controller/irq.h>
#include <dt-bindings/pwm/pwm.h>
#include "imx8mm-pinfunc.h"

#include "verdin-imx8mm_optologic_lvds.dtsi"
#include "display-scx5.dtsi"

&i2c4 {
	touchscreen@41 {
		compatible = "ilitek,ili2132";
		reg = <0x41>;
		pinctrl-names = "default";
		pinctrl-0 = <&pinctrl_gpio_9_dsi>, <&pinctrl_i2s_2_bclk_touch_reset>;
		interrupt-parent = <&gpio3>;
		interrupts = <15 IRQ_TYPE_EDGE_RISING>;
		reset-gpios = <&gpio3 23 GPIO_ACTIVE_LOW>;
        status = "okay";
	};
};
