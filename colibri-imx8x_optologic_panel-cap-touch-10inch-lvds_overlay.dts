// SPDX-License-Identifier: GPL-2.0-or-later OR MIT
/*
* Copyright 2025 OPTO logic technology S.A.
* Author: Enguerrand de Ribaucourt <enguerrand.de.ribaucourt@savoirfairelinux.com>
*/

// Enable the parallel RGB interface on the Colibri iMX8X which communicates
// through X1 SODIMM connector, with the LVDS transceiver on the Iris v2.0A
// connected with an OPTO Logic capacitive touch 10" LVDS display.

// Based on similar colibri-imx8x_panel-cap-touch-10inch-lvds_overlay.dts

#include <dt-bindings/gpio/gpio.h>
#include <dt-bindings/interrupt-controller/irq.h>

/dts-v1/;
/plugin/;

#include "colibri-imx8x_optologic_lvds.dtsi"
#include "display-scx10.dtsi"

&i2c1 {
    touch@41 {
        compatible = "ilitek,ili251x";
        reg = <0x41>;
        pinctrl-names = "default";
        interrupt-parent = <&lsio_gpio3>;
        interrupts = <20 IRQ_TYPE_EDGE_FALLING>;
        reset-gpios = <&lsio_gpio3 24 GPIO_ACTIVE_LOW>;
        status = "okay";
    };
};
