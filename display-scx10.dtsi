// SPDX-License-Identifier: GPL-2.0-or-later OR MIT
/*
 * Copyright © 2024 TecInvent
 * Author: Kevin Detta <kevin.detta@tecinvent.ch>
 * Author: Dina Gomes Dias <dina.gomes@tecinvent.ch>
 */

// SCX 10.1inch LVDS Display Dimensions and Timing (SCX1001511GGC49)

&panel_dpi {
	status = "okay";

	width-mm = <217>;
	height-mm = <136>;

	panel-timing {
		clock-frequency = <64500000>;
		hactive = <1280>;
		hback-porch = <20>;
		hfront-porch = <20>;
		hsync-len = <2>;
		vactive = <800>;
		vback-porch = <5>;
		vfront-porch = <5>;
		vsync-len = <3>;
		de-active = <1>;
		hsync-active = <0>;
		vsync-active = <0>;
		pixelclk-active = <0>;
	};
};
