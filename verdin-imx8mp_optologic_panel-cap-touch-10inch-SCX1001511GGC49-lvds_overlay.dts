// SPDX-License-Identifier: GPL-2.0-or-later OR MIT
/*
 * Copyright © 2024 TecInvent
 * Author: Kevin Detta <kevin.detta@tecinvent.ch>
 * Author: Dina Gomes Dias <dina.gomes@tecinvent.ch>
 */

// Verdin iMX8M Plus single-channel LVDS for 10.1 inch OPTO Logic display (SCX1001511GGC49)
// Extends verdin-imx8mp_panel-cap-touch-10inch-lvds_overlay.dts

/dts-v1/;
/plugin/;

#include <dt-bindings/gpio/gpio.h>
#include <dt-bindings/interrupt-controller/irq.h>
#include <dt-bindings/pwm/pwm.h>
#include "imx8mp-pinfunc.h"

#include "verdin-imx8mp_optologic_lvds.dtsi"
#include "display-scx10.dtsi"

/* Verdin I2C_2_DSI */
&i2c2 {
	touch@41 {
		compatible = "ilitek,ili251x";
		reg = <0x41>;
		pinctrl-names = "default";
		pinctrl-0 = <&pinctrl_i2s_2_d_in_gpio &pinctrl_i2s_2_sync_gpio>;
		interrupt-parent = <&gpio4>;
		/* EF: edge falling */
		interrupts = <31 IRQ_TYPE_EDGE_FALLING>;
		reset-gpios = <&gpio4 30 GPIO_ACTIVE_LOW>;
        status = "okay";
	};
};

// We need to force the parent PLL
// See: https://developer.toradex.com/linux-bsp/application-development/multimedia/display-output-resolution-and-timings-linux/#verdin-imx8m-plus-lvds-known-issues
&media_blk_ctrl {
       assigned-clock-rates = <500000000>, <200000000>,
                               <0>, <0>, <454300000>; // 64.9MHz*7
};
